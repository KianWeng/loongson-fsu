## boot/pmon/Config.in
```kconfig
config BR2_TARGET_PMON
	bool "Loongson pmon"
	help
	  The loongson bootloader pmon. 
	  platforms.

if BR2_TARGET_PMON
config BR2_BOOT_PMON_BOARDNAME
	string "loongson pmon board name"
	help
	  One of pmon supported boards to be built.
	  This will be suffixed with _config to meet pmon
	  standard naming.

config BR2_BOOT_PMON_CUSTOM_LOCAL_PATH
	string "pmon custom source site"
	help
	  custom the pmon source site.

config BR2_BOOT_PMON_VERSION
	string "pmon custom version"
	help
	  custom the pmon version
endif
```

## package/hping/Config.in
```kconfig
config BR2_PACKAGE_HPING
	bool "hping"
	default y
	help
		This is the hping package
```

## package/myqt/Config.in
```kconfig
config BR2_PACKAGE_MYQT
	bool "qt"
	depends on BR2_PACKAGE_QT
	depends on BR2_PACKAGE_QT_GUI_MODULE
	help
	  Qwt is a graphics extension to the Qt GUI application
	  framework. It provides a 2D plotting widget and more.

	  http://qwt.sourceforge.net/
```

## package/pppd-files/Config.in
```kconfig
config BR2_PACKAGE_PPPD_FILES
	bool "pppd files"
	select BR2_PACKAGE_PPPD
	help
	  add pppd files.
```

## package/usbip/Config.in
```kconfig
config BR2_PACKAGE_USBIP
	bool "usbip"
	depends on BR2_TOOLCHAIN_HAS_THREADS # libusb
	select BR2_PACKAGE_LIBUSB
	select BR2_PACKAGE_LIBSYSFS
	help
	  USB enumeration utilities

	  http://linux-usb.sourceforge.net/

comment "usbutils needs a toolchain w/ threads"
	depends on !BR2_TOOLCHAIN_HAS_THREADS
```
